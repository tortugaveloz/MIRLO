# pocket register map
Vendor: litex
Litex SoC 2026-09-29 13:49:59
Registers are 32-bit, read-write, reset 0x0 unless marked. A register's access mark holds for its fields unless they carry their own. Offsets are from the block's base; lines under a group give offsets from that group; [hi:lo] are bit positions; {n}, {i} and the like mark numbered series; 'fields as' and 'values as' point back to an identical list; <NAME> marks a mode.

## Memory map
0xF0000000 APF_AUDIO size 0x10
0xF0000800 APF_BRIDGE size 0x38
0xF0001000 APF_INPUT size 0x30
0xF0001800 APF_INTERACT size 0x10
0xF0002000 APF_VIDEO size 0x4
0xF0002800 CTRL size 0xC
0xF0003000 IDENTIFIER_MEM size 0x4
0xF0003800 MAILBOX size 0x1C
0xF0004000 MRDP size 0x18
0xF0004800 SDRAM size 0x34
0xF0005000 TIMER0 size 0x2C
0xF0005800 UART size 0x20
0xF0006000 VIDEO_FRAMEBUFFER size 0x18
0xF0006800 VIDEO_FRAMEBUFFER_VTG size 0x8

## Interrupts
1 timer0 (TIMER0)
2 uart (UART)

## Further device data
memoryRegions:
  PLIC baseAddress=0xF0C00000 size=0x00400000
  CLINT baseAddress=0xF0010000 size=0x00010000
  ROM baseAddress=0x00000000 size=0x00005800
  SRAM baseAddress=0x10000000 size=0x00002000
  MAIN_RAM baseAddress=0x40000000 size=0x04000000
  VIDEO_FRAMEBUFFER baseAddress=0x40C00000 size=0x00800000
  GEOM_ROM baseAddress=0x20000000 size=0x00008000
  GEOM_RAM baseAddress=0x20008000 size=0x00004000
  AUDIO baseAddress=0x80000000 size=0x00008000
  CSR baseAddress=0xF0000000 size=0x00010000
constants:
  CONFIG_CLOCK_FREQUENCY value=62832000
  CONFIG_CPU_HAS_INTERRUPT value=None
  CONFIG_CPU_RESET_ADDR value=0
  CONFIG_CPU_COUNT value=1
  CONFIG_CPU_ISA value=rv32i2p0_mfc
  CONFIG_CPU_MMU value=sv32
  CONFIG_CPU_DCACHE_SIZE value=8192
  CONFIG_CPU_DCACHE_WAYS value=2
  CONFIG_CPU_DCACHE_BLOCK_SIZE value=64
  CONFIG_CPU_ICACHE_SIZE value=16384
  CONFIG_CPU_ICACHE_WAYS value=4
  CONFIG_CPU_ICACHE_BLOCK_SIZE value=64
  CONFIG_CPU_DTLB_SIZE value=4
  CONFIG_CPU_DTLB_WAYS value=4
  CONFIG_CPU_ITLB_SIZE value=4
  CONFIG_CPU_ITLB_WAYS value=4
  CONFIG_CPU_TYPE_VEXRISCV_SMP value=None
  CONFIG_CPU_VARIANT_STANDARD value=None
  CONFIG_CPU_HUMAN_NAME value=VexRiscv SMP-STANDARD
  CONFIG_CPU_NOP value=nop
  DEPLOYMENT_PLATFORM value=openfpga
  DEPLOYMENT_TARGET value=pocket
  ROM_BOOT_ADDRESS value=1073741824
  VIDEO_FRAMEBUFFER_BASE value=1086324736
  VIDEO_FRAMEBUFFER_HRES value=268
  VIDEO_FRAMEBUFFER_VRES value=240
  VIDEO_FRAMEBUFFER_DEPTH value=16
  MAX_DISPLAY_WIDTH value=268
  MAX_DISPLAY_HEIGHT value=240
  CONFIG_CSR_DATA_WIDTH value=32
  CONFIG_CSR_ALIGNMENT value=32
  CONFIG_BUS_STANDARD value=WISHBONE
  CONFIG_BUS_DATA_WIDTH value=32
  CONFIG_BUS_ADDRESS_WIDTH value=32
  CONFIG_BUS_BURSTING value=0
  CONFIG_CPU_INTERRUPTS value=3
  TIMER0_INTERRUPT value=1
  UART_INTERRUPT value=2

## APF_AUDIO
Base 0xF0000000
0x00 OUT — The entrypoint to the audio buffer. Write two 16 bit signed values (for the left and right audio channels) here. This will push one value into the 4096 record FIFO that represents the audio buffer.
0x04 PLAYBACK_EN — Enable audio playback (reading of the audio buffer) when set to 1. No audio playback otherwise.
  [0] playback_en
0x08 BUFFER_FLUSH — Writing 1 to this register will immediately clear the audio buffer.
  [0] buffer_flush
0x0C BUFFER_FILL — The current fill level of the audio buffer. The buffer is full when set to `0xFFF`
  [11:0] buffer_fill

## APF_BRIDGE
Base 0xF0000800
0x00 REQUEST_READ — Writing 1 to this register will trigger a read request.
  [0] request_read
0x04 REQUEST_WRITE — Writing 1 to this register will trigger a write request.
  [0] request_write
0x08 REQUEST_GETFILE — Writing 1 to this register will trigger a request for the filepath of the active slot.
  [0] request_getfile
0x0C REQUEST_OPENFILE — Writing 1 to this register will trigger a request to change the file in the active slot to the one specified by the path in memory.
  [0] request_openfile
0x10 SLOT_ID — The slot ID defined in `data.json` for the desired asset/slot.
  [15:0] slot_id
0x14 DATA_OFFSET — The offset from the start of the asset in the selected data slot to operate on.
0x18 TRANSFER_LENGTH — The length of data to transfer as part of this bridge operation. A length of `0xFFFFFFFF` will request the entire file (NOTE: As of Pocket firmware 1.1, this is bugged, and you just request the file size instead).
0x1C RAM_DATA_ADDRESS — The address of RISC-V RAM to be manipulated in this operation. It is either the first write address for a read request, or the first read address for a write request.
0x20 FILE_SIZE — The file size on disk of the current selected asset in slot `bridge_slot_id`. Writing to this register will update the internal size representation for this file. Note that if you do this for a readonly file, you will mess up any future reads of that slot ID.
0x24 STATUS — Indicates when the bridge is currently transferring a file. 1 when transferring, 0 otherwise. Clears its value on read.
  [0] status
0x28 CURRENT_ADDRESS — The current address the bridge is operating on. Can be used to show a progress bar/estimate time until completion.
0x2C COMMAND_RESULT_CODE — Reports the results of the recent file command. See https://www.analogue.co/developer/docs/host-target-commands for details on expected codes.
  [2:0] command_result_code
0x30 BOOT_READY — BIOS: SDRAM is ready, the Pocket may load the data slots (sticky until the bitstream reloads).
  [0] boot_ready
0x34 HOST_STATE — bit 0: the Pocket has released the core's reset (Reset Exit). bit 1: the Pocket has written a data slot since the bitstream loaded.
  [1:0] host_state
